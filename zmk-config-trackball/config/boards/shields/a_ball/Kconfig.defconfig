## zmk-config-trackball/config/boards/shields/a_ball/Kconfig.defconfig
```kconfig
if SHIELD_A_BALL

config ZMK_KEYBOARD_NAME
    default "a_ball"
# Other keyboard settings

config ZMK_POINTING
    default y

# Assuming pointing device uses SPI
config SPI
    default y
  
endif 
```
